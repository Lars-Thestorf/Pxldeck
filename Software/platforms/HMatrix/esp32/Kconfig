## Software/platforms/HMatrix/esp32/Kconfig
```kconfig
menu "WebSocket Server"

config WEBSOCKET_SERVER_MAX_CLIENTS
  int "Max clients"
  range 1 1000
  default 20
  help
    Maximum number of clients that the WebSocket
    server can handle at a time.

config WEBSOCKET_SERVER_QUEUE_SIZE
  int "Queue read size"
  range 1 100
  default 10
  help
    Size of the queue to deal with incoming
    WebSocket messages. The queue holds the
    connection, not the actual message.

config WEBSOCKET_SERVER_QUEUE_TIMEOUT
  int "Queue timeout"
  range 0 10000
  default 30
  help
    Timeout for adding new connections to the
    read queue.

config WEBSOCKET_SERVER_TASK_STACK_DEPTH
  int "Stack depth"
  range 3000 20000
  default 6000
  help
    Stack depth for the WebSocket server. The task
    handles reads.

config WEBSOCKET_SERVER_TASK_PRIORITY
  int "Priority"
  range 1 20
  default 5
  help
    Priority for the WebSocket server. The task
    handles reads.

config WEBSOCKET_SERVER_PINNED
  bool "Server pinned to core"
  default false
  help
    Pin the WebSocket server task to a specific core.
    The task handles reads.

config WEBSOCKET_SERVER_PINNED_CORE
  int "Pinned core"
  depends on WEBSOCKET_SERVER_PINNED
  range 0 1
  default 0
  help
    Core that the WebSocket server is pinned to.
    The task handles reads.

endmenu
menu "Example Options"

config LED_PIN
  int "LED GPIO Pin"
  range 0 40
  default 2
  help
    GPIO Connected to LED. Many of the ESP32 development
    boards have one connected to pin 2.

config AP_SSID
  string "Access Point SSID"
  default "ESP32 Test"
  help
    Name of access point that the ESP32 creates.

config AP_PSSWD
  string "Access Point Password"
  default "hello world"
  help
    Password of access point that the ESP32 creates.

endmenu
```

## Software/platforms/HMatrix/esp32/impl/Websocketserver/Kconfig
```kconfig
menu "Example Configuration"

    config ESP_WIFI_SSID
        string "WiFi SSID"
        default "matrix"
        help
            SSID (network name) for the example to connect to.

    config ESP_WIFI_PASSWORD
        string "WiFi Password"
        default "123456789"
        help
            WiFi password (WPA or WPA2) for the example to use.
    config ESP_WIFI_CHANNEL
        int "WiFi Channel"
        range 1 13
        default 1
        help
            WiFi channel (network channel) for the example to use.

    config ESP_MAX_STA_CONN
        int "Maximal STA connections"
        default 4
        help
            Max number of the STA connects to AP.

    config HTV_WEBLOG_URL
	    string "Weblog-URL"
	    default "/log"
	    help
		Access this URL using an webbrowser to access ESPs log messages

    config HTV_WEBLOG_WS_URL
	    string "URL for Websocket"
	    default "/log_ws"
	    help
		URL of Websocket for logmessages communication

endmenu
```
